## firmware/main/Kconfig.projbuild
```kconfig
menu "Xiaozhi Assistant"

config USE_EMOTE_MESSAGE_STYLE
    bool "Use rawdraw 1bpp rendering (no LVGL)"
    default y
    help
        When enabled, the display uses rawdraw 1bpp framebuffer rendering
        instead of LVGL. This is the recommended mode for the ZecTrix
        S3 E-Paper 4.2 board as LVGL causes frequent crashes.

config BOARD_TYPE_ZECTRIX_S3_EPAPER_4_2
    bool "zectrix-s3-epaper-4.2 FT firmware"
    default y
    depends on IDF_TARGET_ESP32S3
    help
        This local repository has been reduced to a single FT-only firmware
        for the zectrix-s3-epaper-4.2 board.

choice ZECTRIX_EPD_PANEL_TYPE
    prompt "ZecTrix EPD panel type"
    default ZECTRIX_EPD_PANEL_4COLOR_SSD2683
    depends on BOARD_TYPE_ZECTRIX_S3_EPAPER_4_2
    help
        Select the e-paper panel connected to the board. The 4-color option
        keeps the existing 1bpp UI framebuffer and converts it to the SSD2683
        2bpp wire format during refresh.

config ZECTRIX_EPD_PANEL_1BPP
    bool "1bpp black/white EPD"

config ZECTRIX_EPD_PANEL_4COLOR_SSD2683
    bool "4-color BWRY SSD2683 EPD"

endchoice

config ZECTRIX_EPD_4COLOR_BOOT_TEST_PATTERN
    bool "Show 4-color EPD test pattern at boot"
    default n
    depends on ZECTRIX_EPD_PANEL_4COLOR_SSD2683
    help
        Show black/white/red/yellow vertical bars once during display
        initialization so a newly connected 4-color panel can be verified.

menu "QWeather (JWT)"

config QWEATHER_API_HOST
    string "QWeather API host"
    default ""
    help
        Per-account API host from the QWeather console, without scheme,
        e.g. abcxyz.qweatherapi.com. Set these values in the local,
        untracked sdkconfig; do not commit them.

config QWEATHER_KEY_ID
    string "Credential ID (JWT kid)"
    default ""

config QWEATHER_PROJECT_ID
    string "Project ID (JWT sub)"
    default ""

config QWEATHER_DEVELOPER_ID
    string "Developer ID (JWT iss)"
    default ""

config QWEATHER_PRIVATE_KEY
    string "Ed25519 private key seed (Base64)"
    default ""
    help
        Base64 of the 32-byte Ed25519 seed, i.e. the last 32 bytes of the
        PKCS#8 DER private key:
          openssl pkey -in ed25519-private.pem -outform DER | tail -c 32 | base64
        Leave empty to disable the weather page fetch.

endmenu

endmenu
```
